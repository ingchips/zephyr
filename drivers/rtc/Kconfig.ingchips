## drivers/rtc/Kconfig.ingchips
```kconfig
# INGCHIPS RTC configuration

# Copyright (c) 2016 Open-RnD Sp. z o.o.
# SPDX-License-Identifier: Apache-2.0
config RTC_INGCHIPS
	bool "RTC Driver for ingchips family of MCUs"
	default y
	depends on DT_HAS_INGCHIPS_ING_RTC_ENABLED
	help
	  Enable GPIO driver for INGCHIPS line of MCUs
```

## drivers/spi/Kconfig.ingchips
```kconfig
# INGCHIPS I2C configuration

# Copyright (c) 2016 Open-RnD Sp. z o.o.
# SPDX-License-Identifier: Apache-2.0
config SPI_INGCHIPS
	bool "SPI Driver for ingchips family of MCUs"
	default y
	depends on DT_HAS_INGCHIPS_ING_SPI_ENABLED
	help
	  Enable GPIO driver for INGCHIPS line of MCUs
```

## dts/bindings/i2s/ing,ingchips-i2s.yaml
```yaml
# ingchips,ing-i2s.yaml
compatible: "ingchips,ing-i2s"
description: I2S controller for INGCHIPS MCUs

include: [i2s-controller.yaml, pinctrl-device.yaml]

properties:
  reg:
    required: true
```

## dts/bindings/rtc/ingchips,ing-rtc.yaml
```yaml
# Copyright (c) 2018, Workaround GmbH
# SPDX-License-Identifier: Apache-2.0

description: INGCHIPS RTC

compatible: "ingchips,ing-rtc"

include: rtc.yaml

properties:
  reg:
    required: true
```
