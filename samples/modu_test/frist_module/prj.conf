## CMakeLists.txt
```
# SPDX-License-Identifier: Apache-2.0

cmake_minimum_required(VERSION 3.20.0)

find_package(Zephyr REQUIRED HINTS $ENV{ZEPHYR_BASE})
project(modu_test)
target_sources(app PRIVATE src/main.c)
target_link_options(app PUBLIC -Wl,--just-symbols=${ZEPHYR_BASE}/../modules/hal/ingchips/bundles/noos_mini/ING9168xx/symdefs.g)
```

## Kconfig
```
# Config for counter alarm sample

# Copyright (c) 2019 Nordic Semiconductor ASA
# SPDX-License-Identifier: Apache-2.0


source "Kconfig.zephyr"
```

## prj.conf
```kconfig
CONFIG_STDOUT_CONSOLE=y
CONFIG_HEAP_MEM_POOL_SIZE=10000
CONFIG_BT=y
CONFIG_BT_HCI=y
CONFIG_BT_CTLR=n
CONFIG_BT_INGCHIPS=y

CONFIG_DEBUG=y
CONFIG_GPIO=y

CONFIG_ADC=y
CONFIG_PINCTRL=y
CONFIG_I2C=y
CONFIG_SPI=y
CONFIG_I2S=y
CONFIG_RTC=y
CONFIG_TIMER=y

CONFIG_LOG=y
CONFIG_BT_HCI_CORE_LOG_LEVEL_DBG=y
CONFIG_BT_HCI_DRIVER_LOG_LEVEL_DBG=y

CONFIG_SYSTEM_WORKQUEUE_STACK_SIZE=2048

CONFIG_BT_SMP=y
CONFIG_BT_SIGNING=y
CONFIG_BT_PERIPHERAL=y
CONFIG_BT_DIS=y
CONFIG_BT_ATT_PREPARE_COUNT=1
# CONFIG_BT_PRIVACY=y
CONFIG_BT_DEVICE_NAME="ING916 Direct Adv"
CONFIG_BT_DEVICE_APPEARANCE=833


# CONFIG_BT_KEYS_OVERWRITE_OLDEST=y
# CONFIG_BT_SETTINGS=y
# CONFIG_FLASH=y
# CONFIG_FLASH_PAGE_LAYOUT=y
# CONFIG_FLASH_MAP=y
# CONFIG_NVS=y
# CONFIG_SETTINGS=y
CONFIG_REBOOT=y
CONFIG_LOG_MODE_MINIMAL=y

CONFIG_BT_HCI_ACL_FLOW_CONTROL=n
CONFIG_BT_HOST_CRYPTO_PRNG=n

CONFIG_BT_TINYCRYPT_ECC=y #ECC error
# CONFIG_BT_HCI_VS_EXT=y

CONFIG_DYNAMIC_THREAD_POOL_SIZE=2
```

## src/main.c
```c
/*
 * Copyright (c) 2012-2014 Wind River Systems, Inc.
 *
 * SPDX-License-Identifier: Apache-2.0
 */

#include <stdio.h>
#include <zephyr/kernel.h>
#include <zephyr/device.h>
#include <zephyr/devicetree.h>

#define LED_ENABLE (1)
#define KEY_ENABLE (0)
#define ADC_ENABLE (0)

#if LED_ENABLE
#include <zephyr/drivers/gpio.h>

#define LED0_MODE DT_ALIAS(led1)
#if DT_NODE_HAS_STATUS(LED0_MODE, okay)
#else
#error "LED0 devicetree alias is not defined"
#endif
static const struct gpio_dt_spec led = GPIO_DT_SPEC_GET(LED0_MODE, gpios);
#endif

#if KEY_ENABLE
#include <zephyr/drivers/gpio.h>

#define BUTTON_NODE DT_ALIAS(key0)

#if (!DT_NODE_HAS_STATUS(BUTTON_NODE, okay))
#error "Unsupported board: button_0 devicetree alias is not defined"
#endif

static const struct gpio_dt_spec button = GPIO_DT_SPEC_GET(BUTTON_NODE, gpios);

/* Button pressed callback function */
void button_pressed(const struct device *dev, struct gpio_callback *cb, uint32_t pins)
{
    printf("Button pressed at pin %d\n", button.pin);
}

/* GPIO callback structure */
static struct gpio_callback button_cb_data;
#endif

#if ADC_ENABLE
#include <zephyr/drivers/adc.h>

//使用别名定义
//#define ADC_NODE DT_ALIAS(vol0)
#define ADC_NODE DT_NODELABEL(adc0)
//#define ADC_NODE_SPACE DT_NODELABEL(vol_channel0)

#if (!DT_NODE_HAS_STATUS(ADC_NODE, okay))
#error "Unsupported board: adc_0 devicetree alias is not defined"
#endif

//#if (!DT_NODE_HAS_STATUS(ADC_NODE_SPACE, okay))
//#error "Unsupported board: adc_0 devicetree alias is not defined"
//#endif

const struct device *adc_dev = DEVICE_DT_GET(ADC_NODE);

//static const struct adc_dt_spec adc_space = ADC_DT_SPEC_GET(ADC_NODE_SPACE);

//static const struct adc_dt_spec adc_space = ADC_DT_SPEC_GET_BY_NAME(ADC_NODE, vol_channel0);
#define ADC_RESOLUTION 12
#define ADC_CHANNEL_ID 1

#endif

int main(void)
{
#if LED_ENABLE
    int ret;
    int vale = 0;

    if (!gpio_is_ready_dt(&led)) {
        return 0;
    }

    ret = gpio_pin_configure_dt(&led, GPIO_OUTPUT_ACTIVE);
    if (ret < 0) {
        return 0;
    }

    while (1) {
//        ret = gpio_pin_toggle_dt(&led);
        ret = gpio_pin_set_dt(&led, vale);
        if (ret < 0) {
            return 0;
        }
        vale = !vale;
        k_msleep(1000);
    }
    return 0;
#endif

#if KEY_ENABLE
    int ret;

    /* Check if the GPIO device is ready */
    if (!device_is_ready(button.port)) {
        printf("Error: button device %s is not ready\n", button.port->name);
        return 0;
    }

    /* Configure the GPIO pin as input with pull-up/pull-down (if necessary) */
    ret = gpio_pin_configure_dt(&button, GPIO_INPUT|GPIO_PULL_UP);
    if (ret != 0) {
        printf("Error %d: failed to configure %s pin %d\n", ret, button.port->name, button.pin);
        return 0;
    }

    /* Configure the interrupt callback for button press */
    ret = gpio_pin_interrupt_configure_dt(&button, GPIO_INT_LEVEL_LOW);
    if (ret != 0) {
        printf("Error %d: failed to configure interrupt on %s pin %d\n", ret, button.port->name, button.pin);
        return 0;
    }

    /* Initialize the GPIO callback structure */
    gpio_init_callback(&button_cb_data, button_pressed, BIT(button.pin));
    gpio_add_callback(button.port, &button_cb_data);

    /* Main loop */
    while (1) {
        /* Read the GPIO pin value */
        int val = gpio_pin_get_dt(&button);
        printf("Button state: %d\n", val);
        k_sleep(K_MSEC(1000));  // Delay for 1 second
    }
    return 0;
#endif

#if ADC_ENABLE

//    const struct device *adc_dev;
    struct adc_channel_cfg channel_cfg;
    struct adc_sequence sequence;
    uint16_t sample_buffer[1];
    int err;

//    adc_dev = device_get_binding(DT_LABEL(DT_NODELABEL(adc0)));
    if (!adc_dev) {
        printf("ADC device not found\n");
        return 0;
    }

    channel_cfg.gain = ADC_GAIN_1;
    channel_cfg.reference = ADC_REF_INTERNAL;
    channel_cfg.acquisition_time = ADC_ACQ_TIME_DEFAULT;
    channel_cfg.channel_id = ADC_CHANNEL_ID;
    channel_cfg.differential = 0;

    err = adc_channel_setup(adc_dev, &channel_cfg);
    if (err) {
        printf("Failed to setup ADC channel (err %d)\n", err);
        return 0;
    }

    sequence.options = NULL;
    sequence.channels = BIT(ADC_CHANNEL_ID);
    sequence.buffer = sample_buffer;
    sequence.buffer_size = sizeof(sample_buffer);
    sequence.resolution = ADC_RESOLUTION;

    err = adc_read(adc_dev, &sequence);
    if (err) {
        printf("ADC read failed (err %d)\n", err);
        return 0;
    }

    printf("ADC value: %d\n", sample_buffer[0]);

    while (1) {
        printf("adc while data\n");
        k_sleep(K_MSEC(1000));  // Delay for 1 second
    }
#endif
}
```
