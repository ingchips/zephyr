## CMakeLists.txt
```
# SPDX-License-Identifier: Apache-2.0

cmake_minimum_required(VERSION 3.13.1)
find_package(Zephyr REQUIRED HINTS $ENV{ZEPHYR_BASE})
project(external_lib)

# target_sources(app PRIVATE src/main_zephyr.c)

# The external static library that we are linking with does not know
# how to build for this platform so we export all the flags used in
# this zephyr build to the external build system.
#
# Other external build systems may be self-contained enough that they
# do not need any build information from zephyr. Or they may be
# incompatible with certain zephyr options and need them to be
# filtered out.
zephyr_get_include_directories_for_lang_as_string(       C includes)
zephyr_get_system_include_directories_for_lang_as_string(C system_includes)
zephyr_get_compile_definitions_for_lang_as_string(       C definitions)
zephyr_get_compile_options_for_lang_as_string(           C options)

set(external_project_cflags
  "${includes} ${definitions} ${options} ${system_includes}"
  )

include(ExternalProject)

# Add an external project to be able download and build the third
# party library. In this case downloading is not necessary as it has
# been committed to the repository.
set(mylib_src_dir   ${CMAKE_CURRENT_SOURCE_DIR}/mylib)
set(mylib_build_dir ${CMAKE_CURRENT_SOURCE_DIR}/mylib)

set(MYLIB_LIB_DIR     ${mylib_build_dir}/lib)
set(MYLIB_INCLUDE_DIR ${mylib_src_dir}/include)
# set(ING_REL ${mylib_src_dir}/ING918XX_SDK_SOURCE)
set(ING_REL ${CMAKE_CURRENT_SOURCE_DIR}/../../../../../Documents/workspace/ING918XX_SDK_SOURCE)
set(ING_BUNDLE ${ING_REL}/bundles/noos_mini/inc)
set(ING_BUNDLE_G ${ING_REL}/bundles/noos_mini/ING9168xx)

include_directories(${MYLIB_INCLUDE_DIR}/../src)

include_directories(${ING_REL}/src/BSP)
include_directories(${ING_REL}/src/FWlib)

include_directories(${ING_REL}/src/StartUP/ing916)
include_directories(${ING_REL}/src/Tools)
include_directories(${ING_BUNDLE})
include_directories(${ING_BUNDLE}/os)

target_sources(app PRIVATE ${mylib_src_dir}/src/main.c)
target_sources(app PRIVATE ${mylib_src_dir}/src/profile.c)
# zephyr_sources_ifdef(CONFIG_BT_INGCHIPS ${mylib_src_dir}/src/h4_ingchips.c)
target_sources(app PRIVATE ${mylib_src_dir}/src/h4_ingchips.c)

# target_sources(app PRIVATE ${mylib_src_dir}/src/uart_console.c)
# target_sources(app PRIVATE ${mylib_src_dir}/src/service_console.c)
target_sources(app PRIVATE ${mylib_src_dir}/portable/gen_os_impl.c)
target_sources(app PRIVATE ${ING_REL}/src/FWlib/peripheral_adc.c)
target_sources(app PRIVATE ${ING_REL}/src/FWlib/peripheral_gpio.c)
target_sources(app PRIVATE ${ING_REL}/src/FWlib/peripheral_i2c.c)
target_sources(app PRIVATE ${ING_REL}/src/FWlib/peripheral_pinctrl.c)
target_sources(app PRIVATE ${ING_REL}/src/FWlib/peripheral_pwm.c)
target_sources(app PRIVATE ${ING_REL}/src/FWlib/peripheral_rtc.c)
target_sources(app PRIVATE ${ING_REL}/src/FWlib/peripheral_ssp.c)
target_sources(app PRIVATE ${ING_REL}/src/FWlib/peripheral_sysctrl.c)
target_sources(app PRIVATE ${ING_REL}/src/FWlib/peripheral_timer.c)
target_sources(app PRIVATE ${ING_REL}/src/FWlib/peripheral_uart.c)
target_sources(app PRIVATE ${ING_REL}/src/FWlib/peripheral_comparator.c)
target_sources(app PRIVATE ${ING_REL}/src/FWlib/peripheral_dma.c)
target_sources(app PRIVATE ${ING_REL}/src/FWlib/peripheral_efuse.c)
target_sources(app PRIVATE ${ING_REL}/src/FWlib/peripheral_i2s.c)
target_sources(app PRIVATE ${ING_REL}/src/FWlib/peripheral_ir.c)
target_sources(app PRIVATE ${ING_REL}/src/FWlib/peripheral_keyscan.c)
target_sources(app PRIVATE ${ING_REL}/src/FWlib/peripheral_pdm.c)
target_sources(app PRIVATE ${ING_REL}/src/FWlib/peripheral_pte.c)
target_sources(app PRIVATE ${ING_REL}/src/FWlib/peripheral_qdec.c)
target_sources(app PRIVATE ${ING_REL}/src/FWlib/peripheral_usb.c)
target_sources(app PRIVATE ${ING_REL}/src/Tools/trace.c)
target_sources(app PRIVATE ${ING_REL}/src/BSP/eflash.c)

add_definitions(-DUSE_STDPERIPH_DRIVER)
add_definitions(-DPOWER_SAVING)
# add_definitions(-DLISTEN_TO_POWER_SAVING)
add_definitions(-DLISTEN_TO_POWER_SAVING)
add_definitions(-DINGCHIPS_FAMILY_916=1)
add_definitions(-DINGCHIPS_FAMILY=1)

# # Create a wrapper CMake library that our app can link with
add_library(mylib_lib STATIC IMPORTED GLOBAL)
add_dependencies(
  mylib_lib
  mylib_project
)

target_link_options(app PUBLIC -Wl,--just-symbols=${ING_BUNDLE_G}/symdefs.g)
message("zyx debug2 ${ING_BUNDLE_G}")
zephyr_library_include_directories(${ZEPHYR_BASE}/samples/bluetooth)
```

## prj.conf
```kconfig
CONFIG_STDOUT_CONSOLE=y
CONFIG_HEAP_MEM_POOL_SIZE=10000

CONFIG_BT=y
CONFIG_BT_HCI=y
CONFIG_BT_CTLR=n
CONFIG_BT_INGCHIPS=y

CONFIG_LOG=y 
CONFIG_BT_HCI_CORE_LOG_LEVEL_DBG=y
CONFIG_BT_HCI_DRIVER_LOG_LEVEL_DBG=y

CONFIG_SYSTEM_WORKQUEUE_STACK_SIZE=2048

CONFIG_BT_SMP=y
CONFIG_BT_SIGNING=y
CONFIG_BT_PERIPHERAL=y
CONFIG_BT_DIS=y
CONFIG_BT_ATT_PREPARE_COUNT=1
# CONFIG_BT_PRIVACY=y
CONFIG_BT_DEVICE_NAME="Direct Adv"
CONFIG_BT_DEVICE_APPEARANCE=833


CONFIG_BT_KEYS_OVERWRITE_OLDEST=y
CONFIG_BT_SETTINGS=y
CONFIG_FLASH=y
CONFIG_FLASH_PAGE_LAYOUT=y
CONFIG_FLASH_MAP=y
CONFIG_NVS=y
# CONFIG_SETTINGS=y
CONFIG_REBOOT=y
CONFIG_LOG_MODE_MINIMAL=y

CONFIG_BT_HCI_ACL_FLOW_CONTROL=n
CONFIG_BT_HOST_CRYPTO_PRNG=n

CONFIG_BT_TINYCRYPT_ECC=y #ECC error
CONFIG_BT_HCI_VS_EXT=y
```

## src/main_zephyr.c
```c
/*  
 * Copyright (c) 2017 Intel Corporation
 *
 * SPDX-License-Identifier: Apache-2.0
 */

/* hello world example: calling functions from a static library */


//no use
#include <zephyr.h>
#include <stdio.h>
#include <mylib.h>
#include "main.h"
void main(void)
{
	printf("Hello World!\n");
	// app_main();
	// mylib_hello_world();
}
```
