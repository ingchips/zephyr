## boards/arm/ing9168_mini/Kconfig.board
```kconfig
# SPDX-License-Identifier: Apache-2.0

config BOARD_INGCHIPS_ING9168
	bool "INGCHIPS DEV BOARD"
	depends on SOC_INGCHIPS_ING9168
```

## boards/arm/ing9168_mini/Kconfig.defconfig
```kconfig
# SPDX-License-Identifier: Apache-2.0

if BOARD_INGCHIPS_ING9168

config BOARD
	default "ingchips dev_boards ing9168"

endif #
```

## boards/arm/ing916_mini/Kconfig.defconfig
```kconfig
# STM32F103RCT6 Mini board configuration

# Copyright (c) 2020 WuhanStudio
# SPDX-License-Identifier: Apache-2.0

if BOARD_ING916_MINI

config BOARD
	default "ing916_mini"

endif # BOARD_ing916_mini
```

## boards/arm/ing916_mini/Kconfig.ing916_mini
```kconfig
# STM32F103RCT6 Mini board configuration

# Copyright (c) 2020 WuhanStudio
# SPDX-License-Identifier: Apache-2.0

config BOARD_ING916_MINI
	bool "ing916 Mini Board"
	select SOC_ING916
```

## boards/arm/ing918_mini/Kconfig.defconfig
```kconfig
# ING918RCT6 Mini board configuration

# Copyright (c) 2020 WuhanStudio
# SPDX-License-Identifier: Apache-2.0

if BOARD_ING918_MINI

config BOARD
	default "ING918_mini"

endif # BOARD_ING918_mini
```

## drivers/adc/Kconfig.ingchips
```kconfig
# ADC configuration options

# Copyright (c) 2019 Intel Corporation
# Copyright (c) 2019 Endre Karlson
# Copyright (c) 2019 Song Qiang <songqiang1304521@gmail.com>
# Copyright (c) 2021 Marius Scholtz, RIC Electronics
# Copyright (c) 2022 Hein Wessels, Nobleo Technology
# SPDX-License-Identifier: Apache-2.0

config ADC_INGCHIPS
	bool "ingchips ADC driver"
	default y
	depends on DT_HAS_INGCHIPS_ING_ADC_ENABLED
	help
	  Enable the driver implementation for the INGCHIPS ADC

if ADC_INGCHIPS

config ADC_INGCHIPS_DMA
	bool "ingchips MCU ADC DMA Support"
	select DMA
	help
	  Enable the ADC DMA mode for ADC instances
	  that enable dma channels in their device tree node.

config ADC_INGCHIPS_SHARED_IRQS
	bool "ingchips ADC shared interrupts"
	default y
	depends on ADC_INGCHIPS && !ADC_INGCHIPS_DMA
	help
	  Enable the use of shared interrupts for families that only have a single interrupt for all ADC's


endif
```

## drivers/pinctrl/Kconfig.ingchips
```kconfig
# SPDX-License-Identifier: Apache-2.0

config PINCTRL_INGCHIPS
	bool "ingchips pin controller"
	default y
	depends on DT_HAS_INGCHIPS_ING_PINCTRL_ENABLED
	help
	  Enables INGCHIPS pin controller
```

## drivers/serial/Kconfig.ingchips
```kconfig
config UART_STELLARIS
	bool "INGCHIPS UART driver"
	default y
	depends on DT_HAS_INGCHIPS_STELLARIS_UART_ENABLED
	select SERIAL_HAS_DRIVER
	select SERIAL_SUPPORT_INTERRUPT
	help
	  This option enables the B91 serial driver.
```

## dts/bindings/adc/ingchips,ing-adc.yaml
```yaml
# SPDX-License-Identifier: Apache-2.0

description: INGCHIPS ing family ADC

compatible: "ingchips,ing-adc"

include: [adc-controller.yaml, pinctrl-device.yaml]

properties:
  reg:
    type: array
    required: true

  interrupts:
    type: array
    required: true

  adc-mode:
    type: string
    enum:
      - different
      - single
  io-channels:
    type: phandle-array
    description: |
      List of input channels. Each channel specifier contains:
      1. Channel number (integer): ADC channel index on the hardware.
      2. Gain setting (integer): Defines the gain configuration.
      3. Acquisition time (integer): Time to sample a value (in microseconds).
  "#io-channel-cells":
    description: |
      Number of cells in each `io-channels` specifier. 
      The order of the parameters must be:
      1. Channel number
      2. Gain setting
      3. Acquisition time
    const: 3

#io-channel-cells:
#  - channel
#  - gain
#  - time

#io-channels:
#  - channel
#  - gain
#  - time
```

## dts/bindings/gpio/ingchips,stellaris-gpio.yaml
```yaml
# SPDX-License-Identifier: Apache-2.0

description: INGCHIPS Stellaris GPIO node

compatible: "ingchips,stellaris-gpio"

include: [gpio-controller.yaml, base.yaml]

properties:
  reg:
    required: true

  interrupts:
    required: true

  "#gpio-cells":
    const: 2

gpio-cells:
  - pin
  - flags
```

## dts/bindings/pinctrl/ingchips,ing-pinctrl.yaml
```yaml
# SPDX-License-Identifier: Apache-2.0
description: |
  Binding for the Ingchips pin-ctrl.
compatible: "ingchips,ing-pinctrl"
include: [base.yaml]

properties:
  reg:
    type: array
    required: true
  pull-list:
    type: string
    enum:
      - pull-up
      - pull-down
      - pull-disable
  out-drivers:
    type: string
    enum:
      - driver-2ma
      - driver-4ma
      - driver-8ma
      - driver-12ma
```

## dts/bindings/serial/ingchips,ing-uart.yaml
```yaml
description: ingchips ing UART

compatible: "ingchips,ing-uart"

include: uart-controller.yaml

properties:
  reg:
    required: true

  interrupts:
    required: true
```

## dts/bindings/serial/ingchips,stellaris-uart.yaml
```yaml
description: ingchips Stellaris UART

compatible: "ingchips,stellaris-uart"

include: uart-controller.yaml

properties:
  reg:
    required: true

  interrupts:
    required: true
```

## soc/arm/ingchips/Kconfig
```kconfig
#INGCHIPS MCU line

# Copyright (c) 2016 Open-RnD Sp. z o.o.
# SPDX-License-Identifier: Apache-2.0

config SOC_FAMILY_INGCHIPS
	bool
	select HAS_SEGGER_RTT if ZEPHYR_SEGGER_MODULE
	select INGCHIPS_ENABLE_DEBUG_SLEEP_STOP if DEBUG || ZTEST
	select BUILD_OUTPUT_HEX

if SOC_FAMILY_INGCHIPS
config SOC_FAMILY
	string
	default "ingchips"

config INGCHIPS_ENABLE_DEBUG_SLEEP_STOP ##todo
	bool "Allow debugger attach in stop/sleep Mode"
	help
	  Some INGCHIPS parts disable the DBGMCU in sleep/stop modes because
	  of power consumption. As a side-effects this prevents
	  debuggers from attaching w/o resetting the target. This
	  effectivly destroys the use-case of `west attach`. Also
	  SEGGER RTT and similar technologies need this.

source "soc/arm/ingchips/*/Kconfig.soc"

endif # SOC_FAMILY_INGCHIPS
```

## soc/arm/ingchips/Kconfig.defconfig
```kconfig
# SPDX-License-Identifier: Apache-2.0

source "soc/arm/ingchips/*/Kconfig.defconfig.series"
```

## soc/arm/ingchips/ing916/Kconfig.defconfig.series
```kconfig
# ST Microelectronics STM32F4 MCU line

# Copyright (c) 2016 Linaro Limited
# SPDX-License-Identifier: Apache-2.0

# Kconfig symbols common to STM32F4 series

if SOC_SERIES_INGCHIPS

source "soc/arm/ingchips/ing916/Kconfig.defconfig.ing916*"

config SOC_SERIES
	default "ing916"

# adjust the fallback because of the LSI oscaillator characteristics
config TASK_WDT_HW_FALLBACK_DELAY
	depends on TASK_WDT_HW_FALLBACK
	default 200

endif # 
```

## soc/arm/ingchips/ing916/Kconfig.series
```kconfig
# ST Microelectronics STM32F4 MCU series

# Copyright (c) 2016 Linaro Limited
# SPDX-License-Identifier: Apache-2.0

config SOC_SERIES_INGCHIPS
	bool "STM32F4x Series MCU"
	select ARM
	select CPU_CORTEX_M4
	select CPU_CORTEX_M_HAS_DWT
	select CPU_HAS_FPU
	select SOC_FAMILY_ING916
	# select HAS_STM32CUBE
	select CPU_HAS_ARM_MPU
	select HAS_SWO
	help
	  Enable support for STM32F4 MCU series
```

## soc/arm/ingchips/ing918/Kconfig.defconfig.ing918xx
```kconfig
# ST Microelectronics STM32F103XX MCU

# Copyright (c) 2017, embedjournal.com
# SPDX-License-Identifier: Apache-2.0

if SOC_ING918

config SOC
	default "ing918"

config NUM_IRQS
	default 43

endif # SOC_STM32F103XB || SOC_STM32F103X8
```

## soc/arm/ingchips/ing918/Kconfig.series
```kconfig
# ST Microelectronics STM32F1 MCU series

# Copyright (c) 2016 Open-RnD Sp. z o.o.
# SPDX-License-Identifier: Apache-2.0

config SOC_SERIES_INGCHIPS_ING918
	bool "ING9187xx Series MCU"
	select ARM
	select CPU_CORTEX_M3
	select CPU_CORTEX_M_HAS_DWT
	select SOC_FAMILY_ING918
	select HAS_SWO
	help
	  Enable support for ingchips MCU series
```

## soc/arm/ingchips/ing918/Kconfig.soc
```kconfig
# ST Microelectronics STM32F1 MCU line

# Copyright (c) 2016 Open-RnD Sp. z o.o.
# Copyright (c) RnDity Sp. z o.o.
# SPDX-License-Identifier: Apache-2.0

choice
	prompt "ingchips MCU Selection"
	depends on SOC_SERIES_ING918

config SOC_INGCHIP_ING918
	bool "INGCHIP_ING918"


endchoice
```

## soc/arm/ingchips_ing9168/Kconfig.soc
```kconfig
# SPDX-License-Identifier: Apache-2.0

config SOC_INGCHIPS_ING9168
	bool "INGCHIPS ING9168"
	select ARM
	select CPU_CORTEX_M4
	select CPU_CORTEX_M_HAS_DWT
	select CPU_HAS_FPU
	select CPU_HAS_ARM_MPU
	select HAS_SWO
	select HAS_PM
	select HAS_POWEROFF
	help
	  Enable support for ING9168
```
